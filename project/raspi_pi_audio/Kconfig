## project/raspi_pi_audio/Kconfig
```kconfig
mainmenu "RT-Thread Project Configuration"

config BSP_DIR
    string
    option env="BSP_ROOT"
    default "."

config RTT_DIR
    string
    option env="RTT_ROOT"
    default "../../rt-thread"

config PKGS_DIR
    string
    option env="PKGS_ROOT"
    default "packages"

source "$RTT_DIR/Kconfig"
source "$PKGS_DIR/Kconfig"

menu "Tensorflow Lite Micro"
    config BSP_USING_TENSORFLOWLITEMICRO
        bool "Enable Tensorflow Lite Micro"
        select RT_USING_CPLUSPLUS
        default n

    if BSP_USING_TENSORFLOWLITEMICRO
        choice
            prompt "Select Offical Example"
            
            config BSP_USING_TENSORFLOWLITEMICRO_AUDIO_EXAMPLE
                bool "Enable Tensorflow Lite Micro audio example"
                default n

            config BSP_USING_TENSORFLOWLITEMICRO_PERSON_EXAMPLE
                bool "Enable Tensorflow Lite Micro person example"
                default n
            
            config BSP_USING_TENSORFLOWLITEMICRO_NO_EXAMPEL
                bool "No Tensorflow Lite Micro example"
                default y
        endchoice

        choice
            prompt "Select Tensorflow Lite Operations Type"

            config BSP_USING_TENSORFLOWLITEMICRO_REFERENCE
                bool "Using Tensorflow Lite reference operations"
                default n

            config BSP_USING_TENSORFLOWLITEMICRO_CMSISNN
                bool "Using Tensorflow Lite CMSIS NN operations"
                default y
        endchoice
    endif
endmenu

config BCM2711_SOC
    bool
    select ARCH_ARM_CORTEX_A72
    select RT_USING_COMPONENTS_INIT
    select RT_USING_USER_MAIN
    select ARCH_CPU_64BIT
    default y

source "driver/Kconfig"
```
